## sdkconfig.defaults
```kconfig
# Arduino 配置选项
CONFIG_FREERTOS_HZ=1000
CONFIG_ARDUINO_RUNNING_CORE=1
CONFIG_ARDUINO_EVENT_RUNNING_CORE=1
CONFIG_ARDUINO_UDP_RUNNING_CORE=1
# CONFIG_ARDUINO_SERIAL_EVENT_RUN_CORE=1  # 未知配置项，已注释

# 启用PSRAM支持（如果硬件支持）
CONFIG_SPIRAM=y
CONFIG_SPIRAM_BOOT_INIT=y
CONFIG_SPIRAM_USE_MALLOC=y
CONFIG_SPIRAM_TYPE_AUTO=y
# CONFIG_SPIRAM_SIZE=-1  # 未知配置项，已注释
CONFIG_SPIRAM_SPEED_80M=y

# 蓝牙配置
CONFIG_BT_ENABLED=n

# 电源管理
CONFIG_PM_ENABLE=n

# 组件配置
CONFIG_ESPTOOLPY_FLASHSIZE_4MB=y
CONFIG_PARTITION_TABLE_SINGLE_APP=y

# Flash
CONFIG_ESPTOOLPY_FLASHMODE_DIO=y
CONFIG_ESPTOOLPY_FLASHFREQ_80M=y

# 控制台
CONFIG_ESP_CONSOLE_UART_DEFAULT=y

# SPI配置
CONFIG_SPI_MASTER_ISR_IN_IRAM=y
CONFIG_SPI_SLAVE_ISR_IN_IRAM=y 
```
